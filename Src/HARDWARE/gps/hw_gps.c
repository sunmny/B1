#include "hw_gps.h" 
#include "hw_config.h"
#include "stm32l4xx_hal.h"
#include "hw_uart.h"
#include "delay.h"
#include "cmsis_os.h"

#include "hw_lora.h"

uint8_t kkk = 0;
/*

#define GPS_POWER_ON_Pin GPIO_PIN_0
#define GPS_POWER_ON_GPIO_Port GPIOC

#define GPS_VDD_EN_Pin GPIO_PIN_12
#define GPS_VDD_EN_GPIO_Port GPIOC

#define GPS_RESET_Pin GPIO_PIN_2
#define GPS_RESET_GPIO_Port GPIOC

*/

//uint8_t bd_open1[76]={0xB5,0x62,0x06,0x3E,0x3C,0x00,0x00,0x00,0x20,0x07,0x00,0x08,0x10,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0x44,0xD2};

uint8_t bd_open1[68]={0xB5,0x62,0x06,0x3E,0x3C,0x00,0x00,0x00,0x20,0x07,0x00,0x08,0x10,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0x2F,0xA1};

uint8_t bd_open2[36]={0xB5,0x62,0x06,0x17,0x14,0x00,0x00,0x41,0x00,0x02,0x00,0x00,0x00,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0x1D,0x5D};

	uint8_t bd_open3[104]={0xB5,0x62,0x06,0x3E,0x3C,0x00,0x00,0x00,0x20,0x07,0x00,0x08,0x10,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0x1D,0x5D};



void hw_gps_power(GPIO_PinState state)
{	
  	//上电  下电
	if(state == GPIO_PIN_SET)
	{
	 HAL_GPIO_WritePin(GPS_POWER_ON_GPIO_Port, GPS_POWER_ON_Pin, state);	
	}
	 HAL_GPIO_WritePin(GPS_VDD_EN_GPIO_Port, GPS_VDD_EN_Pin, state);
}

void hw_gps_reset(GPIO_PinState state)
{
	//reset
   HAL_GPIO_WritePin(GPS_RESET_GPIO_Port, GPS_RESET_Pin, state);
}

uint8_t hw_gps_send(uint8_t *tx_buf, uint16_t tx_len)
{
   return hw_uart1_send(tx_buf,tx_len);
}


uint8_t hw_gps_receive(uint8_t *rx_buf, uint16_t *rx_len,uint32_t timeout)
{
   return hw_uart1_receive(rx_buf,rx_len,timeout);
}

void hw_gps_open(void)
{
	do
	{
   hw_gps_reset(GPIO_PIN_SET);	
   hw_gps_power(GPIO_PIN_SET);
	}while(!HAL_GPIO_ReadPin(GPS_VDD_EN_GPIO_Port, GPS_VDD_EN_Pin))
		;
/*	
	if(kkk == 0)
	{
	//	kkk = 1;
	 //delay_ms(10000);
	 // osDelay(1500);
	// hw_gps_send(bd_open1,68);
	//  delay_ms(4000);
	 // osDelay(1000);
	// hw_gps_send(bd_open2,36);

	//delay_ms(10000);
		osDelay(1500);
	hw_gps_send(bd_open3,104);
		}
	*/
	
	//	delay_ms(20000);
	//hw_gps_send(bd_open3,104);
	
	//		delay_ms(20000);
	//hw_gps_send(bd_open3,104);
}

void hw_gps_close(void)
{
		do
	{
   hw_gps_reset(GPIO_PIN_RESET);	
   hw_gps_power(GPIO_PIN_RESET);
		}while(HAL_GPIO_ReadPin(GPS_VDD_EN_GPIO_Port, GPS_VDD_EN_Pin))
		;
}

void hw_gps_init(void)
{    	 	
    //hw_gps_open();
}





